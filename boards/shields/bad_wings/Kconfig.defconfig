## boards/shields/bad_wings/Kconfig.defconfig
```kconfig
if SHIELD_BAD_WINGS

config ZMK_KEYBOARD_NAME
    default "bad_wings"

endif # SHIELD_BAD_WINGS
```

## boards/shields/bad_wings/Kconfig.shield
```kconfig
config SHIELD_BAD_WINGS
    def_bool $(shields_list_contains,bad_wings)
    select SPI
```

## config/west.yml
```yaml
manifest:
  defaults:
    revision: main
  remotes:
    - name: zmkfirmware
      url-base: https://github.com/zmkfirmware
    - name: zzeneg # <-- required for Raw HID module
      url-base: https://github.com/zzeneg
    - name: srwi # <-- required for KeyPeek module
      url-base: https://github.com/srwi
    - name: benjaminciq
      url-base: https://github.com/BenjaminCIQ
  projects:
    - name: zmk
      remote: zmkfirmware
      import: app/west.yml
    - name: zmk-raw-hid # <-- Raw HID module
      remote: zzeneg
      revision: main
    - name: zmk-keypeek-layer-notifier # <-- KeyPeek module
      remote: srwi
      revision: master
    - name: zmk-dynamic-macros
      remote: benjaminciq
      revision: v0.3 # Match this to your ZMK major.minor
   self:
    path: config
```

## zephyr/Kconfig
```kconfig
config ZMK_CONFIG_REBOOT_TO_BOOTLOADER_AFTER_RESET
    bool "Reboot into the bootloader after settings have been reset"
    depends on ZMK_SETTINGS_RESET_ON_START
```
